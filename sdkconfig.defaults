## sdkconfig.defaults
```kconfig
# ESP-FIDO TinyUSB configuration
# Enable HID for FIDO2 authenticator + CDC for Serial Monitor (debug)
CONFIG_TINYUSB_ENABLED=y
CONFIG_TINYUSB_HID_ENABLED=y
CONFIG_TINYUSB_HID_BUFSIZE=64
CONFIG_TINYUSB_CDC_ENABLED=y
CONFIG_TINYUSB_MSC_ENABLED=n
CONFIG_TINYUSB_MIDI_ENABLED=n
CONFIG_TINYUSB_VIDEO_ENABLED=n
CONFIG_TINYUSB_DFU_RT_ENABLED=n
CONFIG_TINYUSB_DFU_ENABLED=n
CONFIG_TINYUSB_VENDOR_ENABLED=n

# CRITICAL: Disable built-in USB CDC so TinyUSB can use USB-OTG
# Without these, the ESP-IDF USB CDC driver takes over USB-OTG
CONFIG_USB_CDC_ENABLED=n
CONFIG_USB_CDC_RX_BUFSIZE=
CONFIG_USB_CDC_TX_BUFSIZE=

# Console: use UART only (not USB CDC or USB Serial/JTAG)
CONFIG_ESP_CONSOLE_UART_DEFAULT=y
CONFIG_ESP_CONSOLE_UART=y
CONFIG_ESP_CONSOLE_UART_NUM=0
CONFIG_ESP_CONSOLE_UART_BAUDRATE=115200
CONFIG_ESP_CONSOLE_USB_CDC=n
CONFIG_ESP_CONSOLE_USB_SERIAL_JTAG=n
CONFIG_ESP_CONSOLE_SECONDARY_USB_SERIAL_JTAG=n
CONFIG_CONSOLE_UART_DEFAULT=y
CONFIG_CONSOLE_UART=y
CONFIG_CONSOLE_UART_NUM=0
CONFIG_CONSOLE_UART_BAUDRATE=115200

# mbedTLS: enable HKDF for FIDO2 key derivation
CONFIG_MBEDTLS_HKDF_C=y
```
